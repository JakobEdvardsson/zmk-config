#include "skeletyl.dtsi"

// Physical rows run from top to thumbs on D6-D9. Physical columns run from the
// outer finger column to the thumb-side column on D18/D15/D14/D16/D10.
&kscan0 {
    row-gpios // physical rows (read, pull-down)
        = <&pro_micro 6 (GPIO_ACTIVE_HIGH | GPIO_PULL_DOWN)> // row0 D6 (top)
        , <&pro_micro 7 (GPIO_ACTIVE_HIGH | GPIO_PULL_DOWN)> // row1 D7 (home)
        , <&pro_micro 8 (GPIO_ACTIVE_HIGH | GPIO_PULL_DOWN)> // row2 D8 (bottom)
        , <&pro_micro 9 (GPIO_ACTIVE_HIGH | GPIO_PULL_DOWN)> // row3 D9 (thumb)
        ;
    col-gpios // physical columns (driven)
        = <&pro_micro 18 GPIO_ACTIVE_HIGH> // col0 D18 (outermost)
        , <&pro_micro 15 GPIO_ACTIVE_HIGH> // col1 D15
        , <&pro_micro 14 GPIO_ACTIVE_HIGH> // col2 D14
        , <&pro_micro 16 GPIO_ACTIVE_HIGH> // col3 D16
        , <&pro_micro 10 GPIO_ACTIVE_HIGH> // col4 D10 (thumb side)
        ;
};

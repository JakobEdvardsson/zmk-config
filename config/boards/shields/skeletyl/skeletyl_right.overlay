#include "skeletyl.dtsi"

&default_transform {
    col-offset = <5>; // right half occupies matrix columns 5-9
};

// Right half uses different pins from the left: rows run from top to thumbs on
// D15/D14/D16/D10, and columns run from the thumb side outward on D9-D5.
&kscan0 {
    row-gpios // physical rows (read, pull-down)
        = <&pro_micro 15 (GPIO_ACTIVE_HIGH | GPIO_PULL_DOWN)> // row0 D15 (top)
        , <&pro_micro 14 (GPIO_ACTIVE_HIGH | GPIO_PULL_DOWN)> // row1 D14 (home)
        , <&pro_micro 16 (GPIO_ACTIVE_HIGH | GPIO_PULL_DOWN)> // row2 D16 (bottom)
        , <&pro_micro 10 (GPIO_ACTIVE_HIGH | GPIO_PULL_DOWN)> // row3 D10 (thumb)
        ;
    col-gpios // physical columns (driven)
        = <&pro_micro 9 GPIO_ACTIVE_HIGH> // col5 D9 (thumb side)
        , <&pro_micro 8 GPIO_ACTIVE_HIGH> // col6 D8
        , <&pro_micro 7 GPIO_ACTIVE_HIGH> // col7 D7
        , <&pro_micro 6 GPIO_ACTIVE_HIGH> // col8 D6
        , <&pro_micro 5 GPIO_ACTIVE_HIGH> // col9 D5 (outermost)
        ;
};
